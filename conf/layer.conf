## conf/layer.conf
```bitbake
# We have a conf and classes directory, add to BBPATH
BBPATH .= ":${LAYERDIR}"

# We have recipes-* directories, add to BBFILES
BBFILES += "${LAYERDIR}/recipes-*/*/*.bb \
            ${LAYERDIR}/recipes-*/*/*.bbappend"

BBFILE_COLLECTIONS += "meta-scorpion-app"
BBFILE_PATTERN_meta-scorpion-app = "^${LAYERDIR}/"
BBFILE_PRIORITY_meta-scorpion-app = "6"

LAYERDEPENDS_meta-scorpion-app = "core"
LAYERSERIES_COMPAT_meta-scorpion-app = "kirkstone"
```
